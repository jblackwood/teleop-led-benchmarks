## esp32_cam/main/Kconfig.projbuild
```kconfig
menu "Example Configuration"

    config WEBSOCKET_URI
        string "Websocket endpoint URI"
        depends on WEBSOCKET_URI_FROM_STRING
        default "wss://echo.websocket.events"
        help
            URL of websocket endpoint this example connects to and sends echo

    config WS_OVER_TLS_SERVER_AUTH
        bool "Enable WebSocket over TLS with Server Certificate Verification Only"
        default n
        help
            Enables WebSocket connections over TLS (WSS) with server certificate verification.
            This setting mandates the client to verify the servers certificate, while the server
            does not require client certificate verification.

    config TCP_HOST_IP_ADDR
         string "Tcp host address"
         default "0.0.0.0"
         help
            "IpV4 to connect to host ip for tcp connection"
    
    config TCP_HOST_IP_PORT
         string "Tcp host port"
         default "9003"
         help
            "Port to connect to host ip for tcp connection"


endmenu
```
